## zephyr-port/boards/arf/ibex_arty/board.yml
```yaml
board:
  name: ibex_arty
  full_name: ARF Ibex SoC on Arty A7-100T
  vendor: arf
  socs:
    - name: ibex_soc
```

## zephyr-port/drivers/serial/Kconfig
```kconfig
config UART_ARF
	bool "ARF minimal UART driver"
	default y
	depends on DT_HAS_ARF_UART_ENABLED
	select SERIAL_HAS_DRIVER
	help
	  Polling serial driver for the ARF SoC's minimal UART
	  (rtl/system/uart.sv).
```

## zephyr-port/dts/bindings/serial/arf,uart.yaml
```yaml
description: ARF minimal UART (rtl/system/uart.sv — RX +0, TX +4, STATUS +8)

compatible: "arf,uart"

include: uart-controller.yaml

properties:
  reg:
    required: true
```

## zephyr-port/soc/arf/ibex_soc/Kconfig.soc
```kconfig
config SOC_IBEX_SOC
	bool
	help
	  ARF minimal Ibex RISC-V SoC (rv32imc, machine mode, 20 MHz).

config SOC
	default "ibex_soc" if SOC_IBEX_SOC
```
